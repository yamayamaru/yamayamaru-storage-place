/*
 * このプログラムはVision Five2 DebianのSPIテスト用に作ったものです。
 * LCDにILI9486のLCDを使います(SPI接続のみ対応してます)。
 * また、libgpiodとspidev、libfreetypeを使います。
 * 
 * libgpiodのインストールはaptで入ります
 * $ sudo apt install libgpiod2 libgpiod-dev gpiod
 *
 * このプログラムではNotoSansCJK-Regular.ttcを使っているのでインストールされていない場合はaptでfonts-noto-cjk入れるか、
 * 100行目のset_fontの部分で使いたいフォントを指定してください。
 * $ sudo apt install fonts-noto-cjk 
 *
 * また、libfreetype-devもインストールしてください。
 * $ sudo apt install libfreetype-dev
 * 
 * コンパイル方法
 * $ g++ -O2 -I/usr/include/freetype2 -c -o yama_ili9486_library.o yama_ili9486_library.cc
 * $ g++ -O2 -I/usr/include/freetype2 -o spitest_ili9486_double_buffer_draw_char spitest_ili9486_double_buffer_draw_char.cc yama_ili9486_library.o -lgpiod -lfreetype
 *
 * 
 * 実行方法
 *
 * $ sudo chmod o+rw /dev/gpiochip0
 * $ sudo chmod o+rw /dev/spidev1.0
 * $ ./spitest_ili9486_double_buffer_draw_char
 *
 * 
 * VisionFive2とLCDの接続はこんな感じです
 * (libgpiodではピンヘッダのピン番号ではなくpin xxxと書かれてるxxxの部分の番号を指定します
 * 
 * CS    ピンヘッダのピン番号24(pin 49 PAD_GPIO49)    注意：今回はこのピンは使いません
 * MOSI  ピンヘッダのピン番号19(pin 52 PAD_GPIO52)
 * MISO  ピンヘッダのピン番号21(pin 53 PAD_GPIO53)
 * SCLK  ピンヘッダのピン番号23(pin 48 PAD_GPIO48)
 * 
 * RESET ピンヘッダのピン番号31(pin 39 PAD_GPIO39)
 * CS    ピンヘッダのピン番号27(pin 45 PAD_GPIO45)
 * DC    ピンヘッダのピン番号29(pin 37 PAD_GPIO37)
 *
 * (下記のように実行するとピンの利用状況が表示されるようです。)
 * $ sudo cat /sys/kernel/debug/pinctrl/13040000.gpio/pinmux-pins
 *
 */

#include <cstdint>
#include <cstdio>
#include <cstdlib>
#include <csignal>

#include "yama_ili9486_library.h"


// visionfive2のピン設定
#define     SPI_CS        45    //ピンヘッダのピン番号27(pin 45 GPIO45) : UNCLAIMED
#define     SPI_DC        37    //ピンヘッダのピン番号29(pin 37 GPIO37) : UNCLAIMED
#define     SPI_RESET     39    //ピンヘッダのピン番号31(pin 39 GPIO39) : UNCLAIMED
#define     SPIDEV_DEVICE "/dev/spidev1.0"
#define     GPIOD_DEVICE  "/dev/gpiochip0"


FT_Library ft_library01;
FT_Face    ft_face01;

int rnd(int num);
double second();
void sigint_handler(int sig);
void delay(long milli_sec);

void loop();
void main_end();

int main(int argc, char *argv[]) {

    // SIGINTハンドラの設定
    if (signal(SIGINT, sigint_handler) == SIG_ERR) {
        perror("signal SIGINT");
        exit(-1);
    }

    spi_init(SPIDEV_DEVICE, GPIOD_DEVICE, SPI_CS, SPI_DC, SPI_RESET);

    ili9486_init();
    fillRect (0, 0, _width, _height, ILI9486_BLACK);
    set_rotation_ILI9486(3);

    canvas24_begin(480, 321);
    canvas24_set_rotation(0);



    // freetypeの初期化
    int ret;
    if ((ret = init_freetype(&ft_library01)) != 0) {
        perror("init_freetype");
    main_end();
        exit(1);
    }

    // font設定
    if ((ret = set_font(&ft_library01, &ft_face01, "/usr/share/fonts/opentype/noto/NotoSansCJK-Regular.ttc"))) {
        perror("/usr/share/fonts/opentype/noto/NotoSansCJK-Regular.ttc");
        main_end();
        exit(1);
    }

    // fontサイズ設定
    set_font_size(&ft_face01, 16, 300, 300);

    for (int i = 0; i < 20; i++) {
        loop();
    }

    canvas24_end();

    main_end();

    exit(0);

}

void main_end() {
    spi_close();
    gpiod_close();
}

void draw_func01(int32_t num);



// bitmapデータ 320x240 24bitRGB
extern const uint8_t bitmap01[];
// bitmapデータ 320x240 24bitRGB
extern const uint8_t bitmap02[];

void loop(){

    canvas24_set_rotation(0);


    canvas24_fillRect(0, 0, canvas24_width, canvas24_height, ILI9486_BLACK);
    canvas24_update(0, 0);



    // double buffer drawing
    draw_func01(0);

    set_font_size(&ft_face01, 40, 300, 300);
    set_font_color(color24(255, 255, 255), ILI9486_BLACK);
    canvas24_drawChars(&ft_face01, 0, 40, "abcdefg", sizeof("abcdefg"));
    canvas24_drawChars(&ft_face01, 0, 90, "あいうえお", sizeof("あいうえお"));
    canvas24_drawChars(&ft_face01, 0, 140, "ILI9486", sizeof("ILI9486"));
    canvas24_update(0,0);

    delay(5000);



    draw_func01(1);

    char text0001[] = " RISC-V（リスク ファイブ）は、確立された縮小命令セットコンピュータ (RISC) の原則に基づいたオープン標準の命令セットアーキテクチャ (ISA) である。他の多くのISA設計とは異なり、RISC-V ISAは、使用料のかからないオープンソースライセンスで提供されている。多くの企業がRISC-Vハードウェアを提供したり、発表したりしており、RISC-Vをサポートするオープンソースのオペレーティングシステムが利用可能であり、いくつかの一般的なソフトウェアツールチェーンで命令セットがサポートされている。";
    set_font_pos(0, 20);
    set_font_size(&ft_face01, 20, 300, 300);
    set_font_line_height(18);
    canvas24_print(&ft_face01, text0001);
    canvas24_update(0,0);
    delay(10000);



    draw_func01(0);

    std::string text0003 = " RISC-V (pronounced \"risk-five\"[1] where five refers to the number of generations of RISC architecture that were developed at the University of California, Berkeley since 1981[3]) is an open standard instruction set architecture (ISA) based on established RISC principles. Unlike most other ISA designs, RISC-V is provided under open source licenses that do not require fees to use. A number of companies are offering or have announced RISC-V hardware, open source operating systems with RISC-V support are available, and the instruction set is supported in several popular software toolchains. ";
    set_font_pos(0, 25);
    set_font_size(&ft_face01, 25, 300, 300);
    set_font_line_height(22);
    canvas24_word_print(&ft_face01, text0003);
    canvas24_update(0, 0);
    delay(10000);



    draw_func01(1);

    std::string text0005 = " RISC-V (pronounced \"risk-five\"[1] where five refers to the number of generations of RISC architecture that were developed at the University of California, Berkeley since 1981[3]) is an open standard instruction set architecture (ISA) based on established RISC principles. Unlike most other ISA designs, RISC-V is provided under open source licenses that do not require fees to use. A number of companies are offering or have announced RISC-V hardware, open source operating systems with RISC-V support are available, and the instruction set is supported in several popular software toolchains. ";
    set_font_pos(100, 25);
    set_font_size(&ft_face01, 25, 300, 300);
    set_font_line_height(22);
    canvas24_word_print(&ft_face01, text0005);
    canvas24_update(0, 0);
    delay(10000);





    // raspberry
    canvas24_fillRect(0, 0, canvas24_width, canvas24_height, ILI9486_BLACK);
    canvas24_update(0, 0);

    void random_raspberry_loop();
    random_raspberry_loop();




    canvas24_set_rotation(0);



    // ILI9486 LCD direct drawing
    draw_func01(0);

    set_font_size(&ft_face01, 40, 300, 300);
    set_font_color(color24(255, 255, 255), ILI9486_BLACK);
    drawChars(&ft_face01, 0, 40, "abcdefg", sizeof("abcdefg"));
    drawChars(&ft_face01, 0, 90, "あいうえお", sizeof("あいうえお"));
    drawChars(&ft_face01, 0, 140, "ILI9486", sizeof("ILI9486"));

    delay(5000);



    draw_func01(1);

    char text0000[] = " RISC-V（リスク ファイブ）は、確立された縮小命令セットコンピュータ (RISC) の原則に基づいたオープン標準の命令セットアーキテクチャ (ISA) である。他の多くのISA設計とは異なり、RISC-V ISAは、使用料のかからないオープンソースライセンスで提供されている。多くの企業がRISC-Vハードウェアを提供したり、発表したりしており、RISC-Vをサポートするオープンソースのオペレーティングシステムが利用可能であり、いくつかの一般的なソフトウェアツールチェーンで命令セットがサポートされている。";
    set_font_pos(0, 20);
    set_font_size(&ft_face01, 20, 300, 300);
    set_font_line_height(18);
    print(&ft_face01, text0000);
    delay(10000);



    draw_func01(0);

    std::string text0002 = " RISC-V (pronounced \"risk-five\"[1] where five refers to the number of generations of RISC architecture that were developed at the University of California, Berkeley since 1981[3]) is an open standard instruction set architecture (ISA) based on established RISC principles. Unlike most other ISA designs, RISC-V is provided under open source licenses that do not require fees to use. A number of companies are offering or have announced RISC-V hardware, open source operating systems with RISC-V support are available, and the instruction set is supported in several popular software toolchains. ";
    set_font_pos(0, 25);
    set_font_size(&ft_face01, 25, 300, 300);
    set_font_line_height(22);
    word_print(&ft_face01, text0002);
    delay(10000);



    draw_func01(1);

    std::string text0004 = " RISC-V (pronounced \"risk-five\"[1] where five refers to the number of generations of RISC architecture that were developed at the University of California, Berkeley since 1981[3]) is an open standard instruction set architecture (ISA) based on established RISC principles. Unlike most other ISA designs, RISC-V is provided under open source licenses that do not require fees to use. A number of companies are offering or have announced RISC-V hardware, open source operating systems with RISC-V support are available, and the instruction set is supported in several popular software toolchains. ";
    set_font_pos(100, 25);
    set_font_size(&ft_face01, 25, 300, 300);
    set_font_line_height(22);
    word_print(&ft_face01, text0004);
    delay(10000);
}

void draw_func01(int32_t num) {
    int32_t color_depth = 0;
    int32_t color = 0;

    canvas24_fillRect(0, 0, canvas24_width, canvas24_height, ILI9486_BLACK);
    for (int32_t j = 0; j < canvas24_height; j++) {
        for (int32_t i = 0; i < canvas24_width; i++) {
            color_depth = (i + j) * 255 / (canvas24_height + canvas24_width);
            if (num == 0) {
                color = color24(color_depth, 0, 0);
            } else {
                color = color24(0, 0, color_depth);
            }
            canvas24_drawPixel(i, j, color);
        }
    }
    canvas24_update(0, 0);
}





void random_raspberry();
void random_raspberry_setup01(void); 

void random_raspberry_loop() {
    static int r = 0;

    for (int j = 0; j < 6; j++) {
    canvas24_set_rotation(r);
        random_raspberry_setup01();

        for (int i = 0; i < 20; i++) {
            random_raspberry();
        }
        r++;
        if (r >= 4) r = 0;
    }
}

#define RASPBERRY_N  60 
#define RDX        10
#define RDY        10

int random_raspberry_width;
int random_raspberry_height;
extern const uint8_t raspberry_bitmap01[];
extern const uint8_t raspberry_bitmap_mask01[];

struct {
    int    x;
    int    y;
    int    dx;
    int    dy;
    int    signx;
    int    signy;
    int    c;
} raspberry_data01[RASPBERRY_N];

void random_raspberry_setup01(void) {

    random_raspberry_width = canvas24_width;
    random_raspberry_height = canvas24_height;

    for (int i = 0; i < RASPBERRY_N; i++) {
        raspberry_data01[i].x = rnd(random_raspberry_width);
        raspberry_data01[i].y = rnd(random_raspberry_height);
        raspberry_data01[i].dx = rnd(RDX) + 1;
        raspberry_data01[i].dy = rnd(RDY) + 1;
        raspberry_data01[i].signx = rnd(2) ? 1 : -1;
        raspberry_data01[i].signy = rnd(2) ? 1 : -1;
    }
}

void random_raspberry() {

    int temp1, temp2;
    canvas24_fillRect(0, 0, canvas24_width, canvas24_height, ILI9486_BLACK);

    for (int i = 0; i < RASPBERRY_N; i++ ) {
        temp1 = raspberry_data01[i].dx * raspberry_data01[i].signx;
        temp2 = raspberry_data01[i].x + temp1;
        if (temp2 > random_raspberry_width) {
            raspberry_data01[i].signx = -1;
            raspberry_data01[i].dx = rnd(RDX) + 1;
            raspberry_data01[i].x = random_raspberry_width + raspberry_data01[i].signx * raspberry_data01[i].dx;
        } else if (temp2 < 0 ) {
            raspberry_data01[i].signx = 1;
            raspberry_data01[i].dx = rnd(RDX) + 1;
            raspberry_data01[i].x = 0 + raspberry_data01[i].signx * raspberry_data01[i].dx;
        } else {
            raspberry_data01[i].x = raspberry_data01[i].x + temp1;
        } 
        temp1 = raspberry_data01[i].dy * raspberry_data01[i].signy;
        temp2 = raspberry_data01[i].y + temp1;
        if (temp2 > random_raspberry_height) {
            raspberry_data01[i].signy = -1;
            raspberry_data01[i].dy = rnd(RDY) + 1;
            raspberry_data01[i].y = random_raspberry_height + raspberry_data01[i].signy * raspberry_data01[i].dy;
        } else if (temp2 < 0 ) {
            raspberry_data01[i].signy = 1;
            raspberry_data01[i].dy = rnd(RDY) + 1;
            raspberry_data01[i].y = 0 + raspberry_data01[i].signy * raspberry_data01[i].dy;
        } else {
            raspberry_data01[i].y = raspberry_data01[i].y + temp1;
        }

        // ラズベリーのアイコンの描画
        canvas24_drawRGBBitmap_mask(raspberry_data01[i].x, raspberry_data01[i].y, raspberry_bitmap01, raspberry_bitmap_mask01, 32, 32);
    }
    set_font_size(&ft_face01, 32, 300, 300);
    set_font_color(ILI9486_PINK, ILI9486_BLACK);
    canvas24_drawChars(&ft_face01, 0, 34, "VisionFive2", sizeof("Visionfive2"));
    canvas24_update(0, 0);
    delay(10);
}



#include <sys/time.h>
double second()
{


  struct timeval tm;
  double t ;

  static int base_sec = 0,base_usec = 0;

  gettimeofday(&tm, NULL);

  if(base_sec == 0 && base_usec == 0)
    {
      base_sec = tm.tv_sec;
      base_usec = tm.tv_usec;
      t = 0.0;
  } else {
    t = (double) (tm.tv_sec-base_sec) +
      ((double) (tm.tv_usec-base_usec))/1.0e6 ;
  }

  return t ;
}

int rnd(int num) {
    return (rand() % num);
}

struct timespec delay_nano_sleep_param01_req, delay_nano_sleep_param01_rem;

void delay(long milli_sec) {
    int nanosleep_ret;
    delay_nano_sleep_param01_req.tv_sec = milli_sec / 1000;
    delay_nano_sleep_param01_req.tv_nsec = (milli_sec % 1000) * 1000 * 1000;
    nanosleep_ret = nanosleep(&delay_nano_sleep_param01_req, &delay_nano_sleep_param01_rem);
    while (nanosleep_ret == -1) {
        delay_nano_sleep_param01_req.tv_sec = delay_nano_sleep_param01_rem.tv_sec;
        delay_nano_sleep_param01_req.tv_nsec = delay_nano_sleep_param01_rem.tv_nsec;
        nanosleep_ret = nanosleep(&delay_nano_sleep_param01_req, &delay_nano_sleep_param01_rem);
    }
}


void sigint_handler(int sig) {
    spi_close();
    gpiod_close();
    exit(1);
}


// 32x32 ラズベリーマスクデータ(1ピクセル1ビット MSBが先頭)
const uint8_t raspberry_bitmap_mask01[] = {
    0x00,0x00,0x00,0x00,0x00,0x00,0x00,0x00,0x00,0x00,0x00,0x00,0x00,0x00,0x00,0x00,
    0x00,0x7c,0x3e,0x00,0x01,0xff,0xff,0x80,0x01,0xff,0xff,0x80,0x03,0xff,0xff,0xc0,
    0x01,0xff,0xff,0x80,0x01,0xff,0xff,0x80,0x01,0xff,0xff,0x00,0x00,0xff,0xff,0x00,
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    0x00,0x0f,0xf0,0x00,0x00,0x07,0xe0,0x00,0x00,0x00,0x00,0x00,0x00,0x00,0x00,0x00,
};

// 32*32 ラズベリー24bitピクセルRGB画像ーデータ
const uint8_t raspberry_bitmap01[] = {
    0xff,0xff,0xff,0xff,0xff,0xff,0xff,0xff,0xff,0xff,0xff,0xff,0xff,0xff,0xff,
    0xff,0xff,0xff,0xff,0xff,0xff,0xff,0xff,0xff,0xff,0xff,0xff,0xff,0xff,0xff,
    0xff,0xff,0xff,0xff,0xff,0xff,0xff,0xff,0xff,0xff,0xff,0xff,0xff,0xff,0xff,
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    0xff,0xff,0xff,0xff,0xff,0xff,0xff,0xff,0xff,0xff,0xff,0xff
};
